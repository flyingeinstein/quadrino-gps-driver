/dts-v1/;
/plugin/;

// compile with 'make dtoverlay' or use the dtc command:
// dtc -@ -I dts -O dtb -o gps_quadrino.dtbo gps_quadrino-rpi.dts

/ {
    // We could restrict this DT overlay to only RPI or BBB but I see no reason
    // the GPS can't run on any Linux device with an I2C bus.
    // compatible = "brcm,bcm2710brcm,bcm2709";    // RaspberryPI
    // compatible = "ti,am335x-bone-blackti,am335x-boneti,am33xx"; // BeagleBone
    part-number = "gps_quadrino";
    version = "00A0";


    fragment@0 {
        target = <&i2c1>;
        __overlay__ {
            #address-cells = <1>;
            #size-cells = <0>;
            gps_quadrino: gps@20 {
                compatible = "gps_quadrino";
                reg = <0x20>;
            };
        };
    };
};

